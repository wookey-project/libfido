## Kconfig
```kconfig
config USR_LIB_FIDO
bool  "userspace FIDO2 stack"
  default y
  select USR_LIB_USBHID
  ---help---
  Support for FIDO2 protocol

if USR_LIB_FIDO

menu "FIDO options"

config USR_LIB_FIDO_DEBUG
  int "FIDO/U2F stack debug informations level"
  default 0
  range 0 2
  ---help---
  FIDO2 stack debug level. Supported levels are:
    * 0: no debug
    * 1: command execution debug, list received and sent commands
    * 2: command dump debug, dumping complex commands content and
         received and sent data size


config USR_LIB_FIDO_EMULATE_USERPRESENCE
   bool "Emulate user presence event"
   default n
   ---help---
   Instead of waiting for effective user presence event, emulate directly
   user presence as if the user presence backend returned a valid action.

if USR_LIB_FIDO_EMULATE_USERPRESENCE

config USR_LIB_FIDO_EMULATE_NOUSER
   bool "Emulate user absence"
   default n
   ---help---
   Emulate that the user does not acknowledge the host request.

endif

endmenu

endif
```
